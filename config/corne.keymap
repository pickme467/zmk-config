/*
 * Copyright (c) 2024 pickme467
 *
 * SPDX-License-Identifier: MIT
 */

#include <behaviors.dtsi>
#include <dt-bindings/zmk/keys.h>
#include <dt-bindings/zmk/bt.h>
#include "minidox.keymap"

/ {
        chosen {
                zmk,matrix_transform = &five_column_transform;
        };
};
