## boards/shields/gherkin/Kconfig.defconfig
```kconfig
# Copyright (c) 2025 pickme467
# SPDX-License-Identifier: MIT

if SHIELD_GHERKIN
config ZMK_KEYBOARD_NAME
    default "Gherkin"
endif
```

## boards/shields/gherkin/Kconfig.shield
```kconfig
# Copyright (c) 2025 pickme467
# SPDX-License-Identifier: MIT

config SHIELD_GHERKIN
    def_bool $(shields_list_contains,gherkin)
```

## boards/shields/minidox/Kconfig.shield
```kconfig
# Copyright (c) 2024 pickme467
# SPDX-License-Identifier: MIT

config SHIELD_MINIDOX_LEFT
    def_bool $(shields_list_contains,minidox_left)

config SHIELD_MINIDOX_RIGHT
    def_bool $(shields_list_contains,minidox_right)
```
